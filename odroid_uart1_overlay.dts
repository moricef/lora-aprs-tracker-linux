/dts-v1/;
/plugin/;

/ {
    compatible = "hardkernel,odroid-c2", "amlogic,meson-gxbb";

    fragment@0 {
        target = <&uart_A>;
        __overlay__ {
            status = "okay";
            pinctrl-0 = <&uart_a_pins>;
            pinctrl-names = "default";
        };
    };
};
